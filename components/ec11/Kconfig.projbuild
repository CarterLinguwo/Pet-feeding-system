## components/ec11/Kconfig.projbuild
```kconfig
menu "Knob"
    config MAX_GLITCH_NS
        int "Maximum allowable glitch (ns)"
        default 1000
        range 0 1000000
        help
            Pulse width smaller than this threshold will be treated as glitch and ignored, in the unit of ns.

endmenu
```

## components/i2c_bus/Kconfig.projbuild
```kconfig
menu "I2C Bus"
	config I2C_PORT
		int "I2C Port Number"
		default 0
		range -1 1
		help
			I2C port to use (-1 to automatically select).

	config I2C_MASTER_SDA
		int "I2C SDA GPIO Number"
		default 4 if IDF_TARGET_ESP8266
		default 5 if IDF_TARGET_ESP32C3
		default 1 if IDF_TARGET_ESP32 || IDF_TARGET_ESP32S2 || IDF_TARGET_ESP32S3
		help
			GPIO number for I2C master data line.

    config I2C_MASTER_SCL
		int "I2C SCL GPIO Number"
		default 5 if IDF_TARGET_ESP8266
		default 6 if IDF_TARGET_ESP32C3
		default 2 if IDF_TARGET_ESP32 || IDF_TARGET_ESP32S2 || IDF_TARGET_ESP32S3
		help
			GPIO number for I2C master clock line.
endmenu
```
